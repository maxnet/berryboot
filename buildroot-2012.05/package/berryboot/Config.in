## buildroot-2012.05/package/berryboot/Config.in
```kconfig
config BR2_PACKAGE_BERRYBOOT
        bool "berryboot"
    select BR2_PACKAGE_DIALOG
    select BR2_PACKAGE_NCURSES
        help
          Berryboot startup scripts and text interface
```

## buildroot-2012.05/package/berrybootgui/Config.in
```kconfig
config BR2_PACKAGE_BERRYBOOTGUI
        bool "berrybootgui"
    select BR2_PACKAGE_QT
        help
          Berryboot GUI 
```

## buildroot-2012.05/package/berrybootgui2/Config.in
```kconfig
config BR2_PACKAGE_BERRYBOOTGUI2
        bool "berrybootgui 2.0"
    select BR2_PACKAGE_QT
    select BR2_PACKAGE_RPI_USERLAND
        help
          Berryboot GUI 
```

## buildroot-2012.05/package/btrfs-progs/Config.in
```kconfig
config BR2_PACKAGE_BTRFS_PROGS
	bool "btrfs-progs"
	select BR2_PACKAGE_UTIL_LINUX
	select BR2_PACKAGE_UTIL_LINUX_LIBUUID
	select BR2_PACKAGE_ATTR
	help
	  BTRFS user space utilities

	  https://btrfs.wiki.kernel.org/
```

## buildroot-2012.05/package/cryptsetup/Config.in
```kconfig
config BR2_PACKAGE_CRYPTSETUP
        bool "cryptsetup"
    select BR2_PACKAGE_LVM2
    select BR2_PACKAGE_POPT
        help
          Cryptsetup 
```

## buildroot-2012.05/package/netbook-launcher-efl/Config.in
```kconfig
config BR2_PACKAGE_NETBOOK_LAUNCHER_EFL
	bool "netbook-launcher-efl"
	select BR2_PACKAGE_LIBECORE
	select BR2_PACKAGE_LIBECORE_EVAS
	select BR2_PACKAGE_LIBEDJE
	select BR2_PACKAGE_LIBEET
	select BR2_PACKAGE_LIBEINA
	select BR2_PACKAGE_LIBELEMENTARY
	select BR2_PACKAGE_LIBEVAS
	select BR2_PACKAGE_LIBEFREET
	
	help
	  netbook-launcher-efl
	  
	  http://archive.ubuntu.com/ubuntu/pool/universe/n/netbook-launcher-efl
	  
```

## buildroot-2012.05/package/openiscsi/Config.in
```kconfig
config BR2_PACKAGE_OPENISCSI
        bool "openiscsi"
        help
          Open-ISCSI initiator
```

## buildroot-2012.05/package/rpi-userland/Config.in
```kconfig
config BR2_PACKAGE_RPI_USERLAND
        bool "Raspberry Pi userland"
        help
          Raspberry Pi userland libraries 
```

## buildroot-2015.02/package/aufs/Config.in
```kconfig
# Prompt-less option, because this package is not doing anything
# except downloading the AUFS sources. The real work is done by a
# Linux extension.
config BR2_PACKAGE_AUFS
	bool
	depends on BR2_LINUX_KERNEL
	help
	  AUFS
	  This is only the download helper for the kernel patch.

	  http://aufs.sourceforge.net/
```

## buildroot-2015.02/package/berrybootgui2/Config.in
```kconfig
config BR2_PACKAGE_BERRYBOOTGUI2
        bool "berrybootgui 2.0"
    select BR2_PACKAGE_QT
    select BR2_PACKAGE_RPI_USERLAND
    select BR2_PACKAGE_OPENSSL
    select BR2_PACKAGE_LIBCURL
    select BR2_PACKAGE_WPA_SUPPLICANT
    select BR2_PACKAGE_WPA_SUPPLICANT_WPA_CLIENT_SO
        help
          Berryboot GUI 
```

## configs/berryboot_defconfig
```kconfig
BR2_arm=y
BR2_arm1176jzf_s=y
BR2_BACKUP_SITE="http://sources.buildroot.net/"
BR2_DL_DIR="$(TOPDIR)/../dl"
BR2_KERNEL_MIRROR="http://www.kernel.org/pub/"
#BR2_PACKAGE_OVERRIDE_FILE="$(BR2_EXTERNAL)/local.mk"
BR2_KERNEL_HEADERS_4_14=y
BR2_TOOLCHAIN_BUILDROOT_LOCALE=y
BR2_TOOLCHAIN_BUILDROOT_WCHAR=y
BR2_TOOLCHAIN_BUILDROOT_CXX=y
BR2_GCC_ENABLE_LTO=y
BR2_GCC_VERSION_8_X=y
BR2_TARGET_GENERIC_HOSTNAME="berryboot"
BR2_TARGET_GENERIC_ISSUE="Welcome to BerryBoot"
BR2_ROOTFS_DEVICE_CREATION_DYNAMIC_EUDEV=y
BR2_TARGET_GENERIC_GETTY_PORT="tty1"
BR2_TARGET_GENERIC_GETTY_BAUDRATE_115200=y
BR2_SYSTEM_DHCP="eth0"
BR2_ENABLE_LOCALE_WHITELIST="C"
BR2_ROOTFS_POST_BUILD_SCRIPT="$(BERRYBOOTGUI2_PKGDIR)/post-build.sh"
BR2_LINUX_KERNEL_LZO=y
BR2_PACKAGE_BUSYBOX_SHOW_OTHERS=y
#BR2_PACKAGE_ALSA_UTILS=y
# BR2_PACKAGE_ALSA_UTILS_ALSACTL is not set
# BR2_PACKAGE_ALSA_UTILS_ALSAMIXER is not set
#BR2_PACKAGE_ALSA_UTILS_AMIXER=y
BR2_PACKAGE_BTRFS_PROGS=y
BR2_PACKAGE_DOSFSTOOLS=y
BR2_PACKAGE_DOSFSTOOLS_FSCK_FAT=y
BR2_PACKAGE_DOSFSTOOLS_MKFS_FAT=y
# BR2_PACKAGE_E2FSPROGS_BADBLOCKS is not set
# BR2_PACKAGE_E2FSPROGS_CHATTR is not set
# BR2_PACKAGE_E2FSPROGS_DUMPE2FS is not set
# BR2_PACKAGE_E2FSPROGS_E2FREEFRAG is not set
# BR2_PACKAGE_E2FSPROGS_E2UNDO is not set
# BR2_PACKAGE_E2FSPROGS_FILEFRAG is not set
# BR2_PACKAGE_E2FSPROGS_FINDFS is not set
# BR2_PACKAGE_E2FSPROGS_LOGSAVE is not set
# BR2_PACKAGE_E2FSPROGS_LSATTR is not set
BR2_PACKAGE_E2FSPROGS_RESIZE2FS=y
BR2_PACKAGE_HDPARM=y
BR2_PACKAGE_HOST_SQUASHFS=y
BR2_PACKAGE_IW=y
BR2_PACKAGE_SQUASHFS=y
BR2_PACKAGE_SQUASHFS_LZO=y
BR2_PACKAGE_QT_STATIC=y
BR2_PACKAGE_QT_OPENGL=n
BR2_PACKAGE_QT_LICENSE_APPROVED=y
# BR2_PACKAGE_QT_PIXEL_DEPTH_8 is not set
# BR2_PACKAGE_QT_FONT_MICRO is not set
# BR2_PACKAGE_QT_FONT_FIXED is not set
# BR2_PACKAGE_QT_FONT_HELVETICA is not set
BR2_PACKAGE_QT_QTFREETYPE=y
BR2_PACKAGE_QT_QTJPEG=y
BR2_PACKAGE_QT_QTPNG=y
BR2_PACKAGE_QT_SYSTEMZLIB=y
BR2_PACKAGE_QT_GFX_VNC=y
BR2_PACKAGE_QT_MOUSE_PC=y
BR2_PACKAGE_QT_MOUSE_LINUXINPUT=y
BR2_PACKAGE_QT_KEYBOARD_TTY=y
# BR2_PACKAGE_QT_XML is not set
# BR2_PACKAGE_QT_SCRIPT is not set
BR2_PACKAGE_LINUX_FIRMWARE=y
BR2_PACKAGE_LINUX_FIRMWARE_ATHEROS_7010=y
BR2_PACKAGE_LINUX_FIRMWARE_ATHEROS_9271=y
BR2_PACKAGE_LINUX_FIRMWARE_MT7601U=y
BR2_PACKAGE_LINUX_FIRMWARE_RALINK_RT61=y
BR2_PACKAGE_LINUX_FIRMWARE_RALINK_RT73=y
BR2_PACKAGE_LINUX_FIRMWARE_RALINK_RT2XX=y
BR2_PACKAGE_LINUX_FIRMWARE_RTL_81XX=y
BR2_PACKAGE_LINUX_FIRMWARE_RTL_87XX=y
BR2_PACKAGE_LINUX_FIRMWARE_RTL_88XX=y
BR2_PACKAGE_RPI_WIFI_FIRMWARE=y
BR2_PACKAGE_CRYPTSETUP=y
# BR2_PACKAGE_LVM2_STANDARD_INSTALL is not set
BR2_PACKAGE_ALSA_LIB_PCM_PLUGINS=""
# BR2_PACKAGE_ALSA_LIB_ALOAD is not set
# BR2_PACKAGE_ALSA_LIB_RAWMIDI is not set
# BR2_PACKAGE_ALSA_LIB_HWDEP is not set
# BR2_PACKAGE_ALSA_LIB_ALISP is not set
# BR2_PACKAGE_ALSA_LIB_OLD_SYMBOLS is not set
BR2_PACKAGE_LIBNL=y
BR2_PACKAGE_CA_CERTIFICATES=y
BR2_PACKAGE_CRDA=y
BR2_PACKAGE_DROPBEAR=y
# BR2_PACKAGE_DROPBEAR_CLIENT is not set
BR2_PACKAGE_DROPBEAR_DISABLE_REVERSEDNS=y
BR2_PACKAGE_WPA_SUPPLICANT=y
BR2_PACKAGE_WPA_SUPPLICANT_CLI=y
BR2_PACKAGE_WPA_SUPPLICANT_DEBUG_SYSLOG=y
BR2_PACKAGE_UTIL_LINUX_BINARIES=y
BR2_PACKAGE_BERRYBOOTGUI2=y
BR2_PACKAGE_OPENISCSI=y
BR2_PACKAGE_BUSYBOX_STATIC=y
BR2_TARGET_ROOTFS_CPIO=y
BR2_TARGET_ROOTFS_CPIO_UIMAGE=y
BR2_TARGET_ROOTFS_CPIO_LZO=y
# BR2_TARGET_ROOTFS_TAR is not set
```

## external/Config.in
```kconfig
source "$BR2_EXTERNAL_BERRYBOOT_PATH/package/berrybootgui2/Config.in"
source "$BR2_EXTERNAL_BERRYBOOT_PATH/package/openiscsi/Config.in"
source "$BR2_EXTERNAL_BERRYBOOT_PATH/package/busybox-static/Config.in"
```

## external/package/berrybootgui2/Config.in
```kconfig
config BR2_PACKAGE_BERRYBOOTGUI2
        bool "berrybootgui 2.0"
    select BR2_PACKAGE_QT
    select BR2_PACKAGE_RPI_USERLAND
    select BR2_PACKAGE_OPENSSL
    select BR2_PACKAGE_LIBCURL
    select BR2_PACKAGE_WPA_SUPPLICANT
    select BR2_PACKAGE_WPA_SUPPLICANT_WPA_CLIENT_SO
    select BR2_PACKAGE_UTIL_LINUX
    select BR2_PACKAGE_UTIL_LINUX_LIBBLKID
        help
          Berryboot GUI 
```

## external/package/busybox-static/Config.in
```kconfig
config BR2_PACKAGE_BUSYBOX_STATIC
	bool "BusyBox static for initramfs"
	help
	  Static Busybox for initramfs

if BR2_PACKAGE_BUSYBOX_STATIC

config BR2_PACKAGE_BUSYBOX_STATIC_CONFIG
	string "BusyBox configuration file to use?"
	default "$(BR2_EXTERNAL)/package/busybox-static/busybox.config"
	help
	  Some people may wish to use their own modified BusyBox
	  configuration file, and will specify their config file
	  location with this option.

	  Most people will just use the default BusyBox configuration
	  file.

config BR2_PACKAGE_BUSYBOX_STATIC_CONFIG_FRAGMENT_FILES
	string "Additional BusyBox configuration fragment files"
	help
	  A space-separated list of configuration fragment files,
	  that will be merged to the main BusyBox configuration file.

endif
```
